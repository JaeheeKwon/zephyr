## boards/makerbase/mks_canable_v10_pro/Kconfig.mks_canable_v10_pro
```kconfig
# Copyright (c) 2024 Alexander Kozhinov <ak.alexander.kozhinov@gmail.com>
# SPDX-License-Identifier: Apache-2.0

config BOARD_MKS_CANABLE_V10_PRO
	select SOC_STM32F072XB
```

## boards/makerbase/mks_canable_v10_pro/board.yml
```yaml
board:
  name: mks_canable_v10_pro
  full_name: MKS CANable V1.0 Pro
  vendor: makerbase
  socs:
    - name: stm32f072xb
```

## drivers/led/Kconfig.is31fl3731
```kconfig
# Copyright 2025 Jaehee Kwon <jaehee.kwon@gmail.com>
# SPDX-License-Identifier: Apache-2.0

config IS31FL3731
	bool "IS31FL3731 LED driver"
	default y
	depends on DT_HAS_ISSI_IS31FL3731_ENABLED
	select I2C
	help
	  Enable LED driver for IS31FL3731.
	  IS31FL3731 is a matrix LED driver, capable of a maximum of 3.29 mA
	  per LED, or 42 mA total across all LEDs in the 12x16 dot matrix.
	  TODO fix help string
```

## dts/bindings/gpio/ti,sn74hc138.yaml
```yaml
# Copyright (c) 2022, Matthias Freese
# SPDX-License-Identifier: Apache-2.0

description: SN74HC138 SPI based GPIO expander

compatible: "ti,sn74hc138"

include: [gpio-controller.yaml, base.yaml]

properties:
  reg:
    required: true

  "#gpio-cells":
    const: 2

  ngpios:
    type: int
    required: true
    const: 8
    description: Number of GPIOs supported

  input-a-gpios:
    type: phandle-array
    required: true
    description: Pin used to control the A (least significant bit) input of the decoder

  input-b-gpios:
    type: phandle-array
    required: true
    description: Pin used to control the B input of the decoder

  input-c-gpios:
    type: phandle-array
    required: true
    description: Pin used to control the C (most significant bit) input of the decoder

gpio-cells:
  - pin
  - flags
```

## dts/bindings/led/issi,is31fl3731.yaml
```yaml
# Copyright 2023 Daniel DeGrasse <daniel@degrasse.com>
# SPDX-License-Identifier: Apache-2.0
description: ISSI IS31FL3731 LED Matrix Driver

compatible: "issi,is31fl3731"

include: "i2c-device.yaml"

properties:
  sdb-gpios:
    type: phandle-array
    description: |
      Hardware shutdown pin. If routed on the board, this property must be
      present. Set to a logical 1 at boot to exit the device from hardware
      shutdown.

  sync-mode:
    type: string
    default: "none"
    enum:
      - "none"
      - "master"
      - "slave"
    description: |
      This property configures the LED controller as a master or slave
      clock device. This can be used to synchronize the output of multiple
      LED controllers. See SYNC bits in led configuration register for more
      information.
```

## west.yml
```yaml
# The west manifest file for upstream Zephyr.
#
# The per-installation west configuration file, .west/config, sets the
# path to the project containing this file in the [manifest] section's
# "path" variable.
#
# You are free to create your own manifest files and put them in any
# repository you want, to create your own custom Zephyr installations.
# For example, you could create a manifest file in your own out of
# tree application directory, which would pull this zephyr repository
# in as an ordinary project.
#
# You can pass your manifest repositories to west init when creating a
# new Zephyr installation. See the west documentation for more
# information.

manifest:
  defaults:
    remote: upstream

  remotes:
    - name: upstream
      url-base: https://github.com/zephyrproject-rtos
    - name: babblesim
      url-base: https://github.com/BabbleSim

  group-filter: [-babblesim, -optional]

  #
  # Please add items below based on alphabetical order
  # zephyr-keep-sorted-start re(^\s+\- name:)
  projects:
    - name: cmsis-dsp
      revision: d80a49b2bb186317dc1db4ac88da49c0ab77e6e7
      path: modules/lib/cmsis-dsp
    - name: cmsis-nn
      revision: e9328d612ea3ea7d0d210d3ac16ea8667c01abdd
      path: modules/lib/cmsis-nn
    - name: cmsis_6
      repo-path: CMSIS_6
      revision: 6dd50439a9b83398ff2ae1376eef0a2a0b95913b
      path: modules/hal/cmsis_6
      groups:
        - hal
    - name: edtt
      revision: b9ca3c7030518f07b7937dacf970d37a47865a76
      path: tools/edtt
      groups:
        - tools
    - name: fatfs
      revision: 16245c7c41d2b79e74984f49b5202551786b8a9b
      path: modules/fs/fatfs
      groups:
        - fs
    - name: hal_atmel
      revision: ca7e4c6920f44b9d677ed5995ffa169f18a54cdf
      path: modules/hal/atmel
      groups:
        - hal
    - name: hal_espressif
      revision: 1f1d6937f8bdd884f907ef455ea1508822a7d75e
      path: modules/hal/espressif
      west-commands: west/west-commands.yml
      groups:
        - hal
    - name: hal_rpi_pico
      path: modules/hal/rpi_pico
      revision: 7b57b24588797e6e7bf18b6bda168e6b96374264
      groups:
        - hal
    - name: hal_st
      revision: 9f81b4427e955885398805b7bca0da3a8cd9109c
      path: modules/hal/st
      groups:
        - hal
    - name: hal_stm32
      revision: 5cbc642b1a79d4f373b1587f8c3027f31bf0d30c
      path: modules/hal/stm32
      groups:
        - hal
    - name: hostap
      path: modules/lib/hostap
      revision: 8412f4b23b6267ee6035d25515a23aaf243f6ad7
    - name: liblc3
      revision: 48bbd3eacd36e99a57317a0a4867002e0b09e183
      path: modules/lib/liblc3
    - name: libmctp
      revision: b97860e78998551af99931ece149eeffc538bdb1
      path: modules/lib/libmctp
    - name: libmetal
      revision: 14f519529a1e4a46aaea6826f5a41d99a3347276
      path: modules/hal/libmetal
      groups:
        - hal
    - name: littlefs
      path: modules/fs/littlefs
      groups:
        - fs
      revision: 8f5ca347843363882619d8f96c00d8dbd88a8e79
    - name: loramac-node
      revision: fb00b383072518c918e2258b0916c996f2d4eebe
      path: modules/lib/loramac-node
    - name: lvgl
      revision: 1ed1ddd881c3784049a92bb9fe37c38c6c74d998
      path: modules/lib/gui/lvgl
    - name: mbedtls
      revision: 5f889934359deccf421554c7045a8381ef75298f
      path: modules/crypto/mbedtls
      groups:
        - crypto
    - name: mcuboot
      revision: 990b1fcb367e27056b282f183e819964fdbfe907
      path: bootloader/mcuboot
      groups:
        - bootloader
    - name: mipi-sys-t
      path: modules/debug/mipi-sys-t
      groups:
        - debug
      revision: 33e5c23cbedda5ba12dbe50c4baefb362a791001
    - name: net-tools
      revision: 986bfeb040df3d9029366de8aea4ce1f84e93780
      path: tools/net-tools
      groups:
        - tools
    - name: open-amp
      revision: f7f4d083c7909a39d86e217376c69b416ec4faf3
      path: modules/lib/open-amp
    - name: openthread
      revision: 3ae741f95e7dfb391dec35c48742862049eb62e8
      path: modules/lib/openthread
    - name: percepio
      path: modules/debug/percepio
      revision: 49e6dc202aa38c2a3edbafcc2dab85dec6aee973
      groups:
        - debug
    - name: picolibc
      path: modules/lib/picolibc
      revision: 560946f26db075c296beea5b39d99e6de43c9010
    - name: segger
      revision: cf56b1d9c80f81a26e2ac5727c9cf177116a4692
      path: modules/debug/segger
      groups:
        - debug
    - name: tinycrypt
      revision: 1012a3ebee18c15ede5efc8332ee2fc37817670f
      path: modules/crypto/tinycrypt
      groups:
        - crypto
    - name: trusted-firmware-a
      revision: 713ffbf96c5bcbdeab757423f10f73eb304eff07
      path: modules/tee/tf-a/trusted-firmware-a
      groups:
        - tee
    - name: trusted-firmware-m
      revision: c150f48855f04d77451a39bfaa80d14eb61d918b
      path: modules/tee/tf-m/trusted-firmware-m
      groups:
        - tee
    - name: uoscore-uedhoc
      revision: 54abc109c9c0adfd53c70077744c14e454f04f4a
      path: modules/lib/uoscore-uedhoc
    - name: zcbor
      revision: 9b07780aca6fb21f82a241ba386ad9b379809337
      path: modules/lib/zcbor
  # zephyr-keep-sorted-stop

  self:
    path: zephyr
    west-commands: scripts/west-commands.yml
    import: submanifests
```
